## west.yml
```yaml
manifest:
  remotes:
    - name: JsmnRepo
      url-base: https://github.com/zserge
    - name: LairdCP
      url-base: https://github.com/LairdCP
    - name: ncs
      url-base: https://github.com/nrfconnect

  # Please add items below based on alphabetical order.
  # These dependencies may need updating if new features are added to the firmware.
  projects:
    - name: zephyr_framework
      path: modules/framework
      revision: ab025edc9245cedfd82c90d3054f168dd9f1f1cb
      remote: LairdCP
    - name: jsmn
      path: modules/jsmn
      revision: 7b6858a5855299d173c5ab2b46e611bf9961cbef
      remote: JsmnRepo
    - name: memfault-firmware-sdk
      path: modules/memfault-firmware-sdk
      revision: 0.11.2
      remote: LairdCP
    - name: Pinnacle-100-firmware
      path: pinnacle_100_firmware
      revision: 86f670b56aad91fefa1387d4889582e0ca16f34e
      url: https://github.com/LairdCP/Pinnacle_100_custom_ble_sensor.git
    - name: sdk-nrf
      path: nrf
      revision: a1e9002a192f594a19b0f434c4f3b0894e560288
      remote: LairdCP
      import: true
    - name: zephyr
      west-commands: scripts/west-commands.yml
      revision: 4ce908a2342494c19df09f347ce79ab81b415185
      remote: LairdCP
      import: true
    - name: zephyr_boards
      path: pinnacle_100_firmware/boards/arm
      revision: f12ea491dc15ea927bdd5a83d30049aea4811b27
      remote: LairdCP
    - name: zephyr_lib
      path: modules/zephyr_lib
      revision: 117023cddec2662f0f65242e990c0af21dbaa1ff
      remote: LairdCP

  self:
    path: pinnacle_100_firmware_public_manifest
```
